## drivers/firmware/arm_scmi/Kconfig
```kconfig
# SPDX-License-Identifier: GPL-2.0-only
menu "ARM System Control and Management Interface Protocol"

if ARM_SCMI_PROTOCOL

config QTI_SCMI_PMU_PROTOCOL
	tristate "Qualcomm Technologies, Inc. SCMI PMU vendor Protocol"
	depends on ARM || ARM64 || COMPILE_TEST
	depends on ARM_SCMI_PROTOCOL && QCOM_CPUCP
	help
	  System Control and Management Interface (SCMI) pmu vendor protocol.
	  This protocol provides interface to communicate with micro controller
	  which maintains the PMU configuration for multiple clients.

	  This driver defines the commands or message ID's used for this
	  communication and also exposes the ops used by clients.

config QTI_SCMI_VENDOR_PROTOCOL
	tristate "Qualcomm Technologies, Inc. Qcom SCMI vendor Protocol"
	depends on ARM || ARM64 || COMPILE_TEST
	depends on ARM_SCMI_PROTOCOL && QCOM_CPUCP
	help
	  System Control and Management Interface (SCMI) Qcom vendor protocol.
	  This protocol provides interface to communicate with micro controller.

	  This driver defines the commands or message ID's used for this
	  communication and also exposes the ops used by clients.

config QTI_SCMI_C1DCVS_PROTOCOL
	tristate "Qualcomm Technologies, Inc. SCMI C1DCVS vendor Protocol"
	depends on ARM || ARM64 || COMPILE_TEST
	depends on ARM_SCMI_PROTOCOL && QCOM_CPUCP
	help
	  System Control and Management Interface (SCMI) c1dcvs vendor protocol.
	  This protocol provides interface to communicate with micro controller
	  which maintains the c1dcvs algorithm.

	  This driver defines the comands or message ID's used for this
	  communication and also exposes the ops used by clients.

config QTI_SCMI_PLH_PROTOCOL
	tristate "Qualcomm Technologies, Inc. SCMI PLH vendor Protocol"
	depends on ARM_SCMI_PROTOCOL && QCOM_CPUCP
	help
	  System Control and Management Interface (SCMI) plh vendor protocol
	  this protocol provides interface to communicate with micro controller
	  which is executing the plh algorithm.

config ARM_SCMI_QUIRKS
	bool "Enable SCMI Quirks framework"
	depends on JUMP_LABEL || COMPILE_TEST
	default y
	help
	  Enables support for SCMI Quirks framework to workaround SCMI platform
	  firmware bugs on system already deployed in the wild.

	  The framework allows the definition of platform-specific code quirks
	  that will be associated and enabled only on the desired platforms
	  depending on the SCMI firmware advertised versions and/or machine
	  compatibles.

source "drivers/firmware/arm_scmi/transports/Kconfig"
source "drivers/firmware/arm_scmi/vendors/imx/Kconfig"
	  This driver defines the comands or message ID's used for this
	  communication and also exposes the ops used by clients.

endif #ARM_SCMI_PROTOCOL

endmenu
```
