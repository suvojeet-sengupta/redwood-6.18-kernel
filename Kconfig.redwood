## drivers/usb/dwc3/Kconfig
```kconfig
# SPDX-License-Identifier: GPL-2.0

if USB_DWC3

config USB_DWC3_ULPI
	bool "Register ULPI PHY Interface"
	depends on USB_ULPI_BUS=y || USB_ULPI_BUS=USB_DWC3
	help
	  Select this if you have ULPI type PHY attached to your DWC3
	  controller.

choice
	prompt "DWC3 Mode Selection"
	default USB_DWC3_DUAL_ROLE if (USB && USB_GADGET)
	default USB_DWC3_HOST if (USB && !USB_GADGET)
	default USB_DWC3_GADGET if (!USB && USB_GADGET)

config USB_DWC3_HOST
	bool "Host only mode"
	depends on USB=y || USB=USB_DWC3
	help
	  Select this when you want to use DWC3 in host mode only,
	  thereby the gadget feature will be regressed.

config USB_DWC3_GADGET
	bool "Gadget only mode"
	depends on USB_GADGET=y || USB_GADGET=USB_DWC3
	help
	  Select this when you want to use DWC3 in gadget mode only,
	  thereby the host feature will be regressed.

config USB_DWC3_DUAL_ROLE
	bool "Dual Role mode"
	depends on ((USB=y || USB=USB_DWC3) && (USB_GADGET=y || USB_GADGET=USB_DWC3))
	help
	  This is the default mode of working of DWC3 controller where
	  both host and gadget features are enabled.

endchoice

comment "Platform Glue Driver Support"

config USB_DWC3_MSM
	tristate "QTI MSM Platforms"
	depends on ARCH_QCOM || COMPILE_TEST
	help
	  Applicable to QTI MSM Platforms with DesignWare Core
	  USB3 IP.
	  Driver supports host, device and dual-role modes of operation.
	  Say 'Y' or 'M' if you have one such device.

config USB_DWC3_AM62
	tristate "Texas Instruments AM62 Platforms"
	depends on ARCH_K3 || COMPILE_TEST
	default USB_DWC3
	help
	  Support TI's AM62 platforms with DesignWare Core USB3 IP.
	  The Designware Core USB3 IP is programmed to operate in
	  in USB 2.0 mode only.
	  Say 'Y' or 'M' here if you have one such device

config USB_DWC3_OCTEON
	tristate "Cavium Octeon Platforms"
	depends on CAVIUM_OCTEON_SOC || COMPILE_TEST
	default USB_DWC3
	help
	  Support Cavium Octeon platforms with DesignWare Core USB3 IP.
	  Only the host mode is currently supported.
	  Say 'Y' or 'M' here if you have one such device.

config USB_DWC3_RTK
	tristate "Realtek DWC3 Platform Driver"
	depends on OF && ARCH_REALTEK
	default USB_DWC3
	select USB_ROLE_SWITCH
	help
	  RTK DHC RTD SoCs with DesignWare Core USB3 IP inside,
	  and IP Core configured for USB 2.0 and USB 3.0 in host
	  or dual-role mode.
	  Say 'Y' or 'M' if you have such device.

config USB_DWC3_GENERIC_PLAT
	tristate "DWC3 Generic Platform Driver"
	depends on OF && COMMON_CLK
	default USB_DWC3
	help
	  Support USB3 functionality in simple SoC integrations.
	  Currently supports SpacemiT DWC USB3. Platforms using
	  dwc3-of-simple can easily switch to dwc3-generic by flattening
	  the dwc3 child node in the device tree.
	  Say 'Y' or 'M' here if your platform integrates DWC3 in a similar way.

endif
```

## drivers/usb/typec/mux/Kconfig
```kconfig
# SPDX-License-Identifier: GPL-2.0-only
#
# Type-C mux drivers
#

config TYPEC_MUX_PS883X
	tristate "Parade PS883x Type-C retimer driver"
	depends on I2C
	depends on DRM || DRM=n
	select DRM_AUX_BRIDGE if DRM_BRIDGE && OF
	select REGMAP_I2C
	help
	  Say Y or M if your system has a On Semiconductor NB7VPQ904M Type-C
	  redriver chip found on some devices with a Type-C port.

config TYPEC_MUX_PS883X
	tristate "Parade PS883x Type-C retimer driver"
	depends on I2C
	depends on DRM || DRM=n
	select DRM_AUX_BRIDGE if DRM_BRIDGE && OF
	select REGMAP_I2C
	help
	  Say Y or M if your system has a Parade PS883x Type-C retimer chip
	  found on some devices with a Type-C port.

config TYPEC_MUX_PTN36502
	tristate "NXP PTN36502 Type-C redriver driver"
	depends on I2C
	depends on DRM || DRM=n
	select DRM_AUX_BRIDGE if DRM_BRIDGE && OF
	select REGMAP_I2C
	help
	  Say Y or M if your system has a NXP PTN36502 Type-C redriver chip
	  found on some devices with a Type-C port.

config TYPEC_MUX_TUSB1046
	tristate "TI TUSB1046 Type-C crosspoint switch driver"
	depends on I2C
	help
	  Driver for the Texas Instruments TUSB1046-DCI crosspoint switch.
	  Supports flipping USB-C SuperSpeed lanes to adapt to orientation
	  changes, as well as muxing DisplayPort and sideband signals to a
	  common Type-C connector.

config TYPEC_MUX_WCD939X_USBSS
	tristate "Qualcomm WCD939x USBSS Analog Audio Switch driver"
	depends on I2C
	select REGMAP_I2C
	help
	  Driver for the Qualcomm WCD939x Audio Codec USBSS domain which
	  provides support for muxing analog audio and sideband signals on a
	  common USB Type-C connector.
	  If compiled as a module, the module will be named wcd939x-usbss.

endmenu
	  Say Y or M if your system has a Parade PS883x Type-C retimer chip
	  found on some devices with a Type-C port.
```

## drivers/usb/typec/ucsi/Kconfig
```kconfig
# SPDX-License-Identifier: GPL-2.0

if TYPEC_UCSI

config UCSI_CCG
	tristate "UCSI Interface Driver for Cypress CCGx"
	depends on I2C
	help
	  This driver enables UCSI support on platforms that expose a
	  Cypress CCGx Type-C controller over I2C interface.

	  To compile the driver as a module, choose M here: the module will be
	  called ucsi_ccg.

config UCSI_ACPI
	tristate "UCSI ACPI Interface Driver"
	depends on ACPI
	help
	  This driver enables UCSI support on platforms that expose UCSI
	  interface as ACPI device. On new Intel Atom based platforms starting
	  from Broxton SoCs and Core platforms stating from Skylake, UCSI is an
	  ACPI enumerated device.

	  To compile the driver as a module, choose M here: the module will be
	  called ucsi_acpi

config UCSI_STM32G0
	tristate "UCSI Interface Driver for STM32G0"
	depends on I2C
	help
	  This driver enables UCSI support on platforms that expose a STM32G0
	  Type-C controller over I2C interface.

	  To compile the driver as a module, choose M here: the module will be
	  called ucsi_stm32g0.

config UCSI_PMIC_GLINK
	tristate "UCSI Qualcomm PMIC GLINK Interface Driver"
	depends on QCOM_PMIC_GLINK
	help
	  This driver enables UCSI support on platforms that expose UCSI
	  interface as PMIC GLINK device.

	  To compile the driver as a module, choose M here: the module will be
	  called ucsi_glink.

config CROS_EC_UCSI
	tristate "UCSI Driver for ChromeOS EC"
	depends on MFD_CROS_EC_DEV
	depends on CROS_USBPD_NOTIFY
	default MFD_CROS_EC_DEV
	help
	  This driver enables UCSI support for a ChromeOS EC. The EC is
	  expected to implement a PPM.

	  To compile the driver as a module, choose M here: the module
	  will be called cros_ec_ucsi.

config UCSI_LENOVO_YOGA_C630
	tristate "UCSI Interface Driver for Lenovo Yoga C630"
	depends on EC_LENOVO_YOGA_C630
	depends on DRM || !DRM
	select DRM_AUX_HPD_BRIDGE if DRM_BRIDGE && OF
config UCSI_QTI_GLINK
	tristate "UCSI Interface Driver for QTI PMIC"
	depends on QTI_PMIC_GLINK
	help
	  This driver enables UCSI support on Qualcomm Technologies, Inc.
	  platforms that expose UCSI interface to communicate with PPM which is
	  charger firmware running on the remote subsystem (e.g. DSP) over PMIC
	  Glink.

	  To compile the driver as a module, choose M here: the module will be
	  called ucsi_qti_glink.

config UCSI_HUAWEI_GAOKUN
	tristate "UCSI Interface Driver for Huawei Matebook E Go"
	depends on EC_HUAWEI_GAOKUN
	depends on DRM || !DRM
	select DRM_AUX_HPD_BRIDGE if DRM_BRIDGE && OF
	help
	  This driver enables UCSI support on the Huawei Matebook E Go tablet,
	  which is a sc8280xp-based 2-in-1 tablet.

	  To compile the driver as a module, choose M here: the module will be
	  called ucsi_huawei_gaokun.

endif
```
