## sound/usb/Kconfig
```kconfig
# SPDX-License-Identifier: GPL-2.0-only
# ALSA USB drivers

if SND_USB && USB

config SND_USB_AUDIO_QMI
	tristate "USB Audio QMI Service driver"
	depends on QCOM_QMI_HELPERS && SND_USB_AUDIO
	help
	  Say Y here to support input controllers like buttons, knobs,
	  alpha dials and analog pedals on the following products:

	   * Native Instruments RigKontrol2
	   * Native Instruments RigKontrol3
	   * Native Instruments Kore Controller
	   * Native Instruments Kore Controller 2
	   * Native Instruments Audio Kontrol 1
	   * Native Instruments Traktor Kontrol S4
	   * Native Instruments Maschine Controller

config SND_USB_US122L
	tristate "Tascam US-122L USB driver"
	depends on X86 || COMPILE_TEST
	select SND_HWDEP
	select SND_RAWMIDI
	help
	  Say Y here to include support for Tascam US-122L USB Audio/MIDI
	  interfaces.

	  To compile this driver as a module, choose M here: the module
	  will be called snd-usb-us122l.

config SND_USB_US144MKII
	tristate "Tascam US-144MKII USB driver"
	depends on X86 || COMPILE_TEST
	select SND_RAWMIDI
	select SND_PCM
	help
	  Say Y here to include support for Tascam US-144MKII USB Audio/MIDI
	  interface.

	  To compile this driver as a module, choose M here: the module
	  will be called snd-usb-us144mkii.

config SND_USB_6FIRE
	tristate "TerraTec DMX 6Fire USB"
	select FW_LOADER
	select BITREVERSE
	select SND_RAWMIDI
	select SND_PCM
	select SND_VMASTER
	help
	  Say Y here to include support for TerraTec 6fire DMX USB interface.

	  You will need firmware files in order to be able to use the device
	  after it has been coldstarted. An install script for the firmware
	  and further help can be found at
	  http://sixfireusb.sourceforge.net

config SND_USB_HIFACE
	tristate "M2Tech hiFace USB-SPDIF driver"
	select SND_PCM
	help
	  Select this option to include support for M2Tech hiFace USB-SPDIF
	  interface.

	  This driver supports the original M2Tech hiFace and some other
	  compatible devices. The supported products are:

	    * M2Tech Young
	    * M2Tech hiFace
	    * M2Tech North Star
	    * M2Tech W4S Young
	    * M2Tech Corrson
	    * M2Tech AUDIA
	    * M2Tech SL Audio
	    * M2Tech Empirical
	    * M2Tech Rockna
	    * M2Tech Pathos
	    * M2Tech Metronome
	    * M2Tech CAD
	    * M2Tech Audio Esclusive
	    * M2Tech Rotel
	    * M2Tech Eeaudio
	    * The Chord Company CHORD
	    * AVA Group A/S Vitus

	  To compile this driver as a module, choose M here: the module
	  will be called snd-usb-hiface.

config SND_BCD2000
	tristate "Behringer BCD2000 MIDI driver"
	select SND_RAWMIDI
	help
	  Say Y here to include MIDI support for the Behringer BCD2000 DJ
	  controller.

	  Audio support is still work-in-progress at
	  https://github.com/anyc/snd-usb-bcd2000

	  To compile this driver as a module, choose M here: the module
	  will be called snd-bcd2000.

config SND_USB_AUDIO_QMI
	tristate "Qualcomm Audio Offload driver"
	depends on QCOM_QMI_HELPERS && SND_USB_AUDIO && SND_SOC_USB
	depends on USB_XHCI_HCD && USB_XHCI_SIDEBAND
	select AUXILIARY_BUS
	help
	  Say Y here to enable the Qualcomm USB audio offloading feature.

	  This module sets up the required QMI stream enable/disable
	  responses to requests generated by the audio DSP.  It passes the
	  USB transfer resource references, so that the audio DSP can issue
	  USB transfers to the host controller.

	  To compile this driver as a module, choose M here: the module
	  will be called snd-usb-audio-qmi.

source "sound/usb/line6/Kconfig"
	  Starts USB Audio QMI server to communicate with remote entity
	  to perform operations like enable or disable particular audio
	  stream on a connected USB device, subsystem restart and
	  device disconnect.

endif	# SND_USB
```
